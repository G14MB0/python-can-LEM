VERSION ""

NS_ :

BS_:

BU_:

BO_ 3221225472 VECTOR__INDEPENDENT_SIG_MSG: 0 Vector__XXX
 SG_ ERROR_INFORMATION : 0|7@0+ (1,0) [0|0] "" Vector__XXX

BO_ 962 CSM_BAT_CURRENT: 5 Vector__XXX
 SG_ ERROR_INDICATION : 39|1@0+ (1,0) [0|1] "" Vector__XXX
 SG_ CSM_BAT_CURRENT : 7|32@0+ (1,-2147483648) [-2147483648|2147483647] "mA" Vector__XXX

CM_ BO_ 3221225472 "This is a message for not used signals, created by Vector CANdb++ DBC OLE DB Provider.";
